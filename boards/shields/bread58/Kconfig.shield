## boards/shields/bread58/Kconfig.shield
```kconfig
# Copyright (c) 2020 Pete Johanson
# SPDX-License-Identifier: MIT

config SHIELD_BREAD58_LEFT
    def_bool $(shields_list_contains,bread58_left)

config SHIELD_BREAD58_RIGHT
    def_bool $(shields_list_contains,bread58_right)
```
